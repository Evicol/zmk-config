## config/west.yml
```yaml
manifest:
  remotes:
    - name: zmkfirmware
      url-base: https://github.com/zmkfirmware
    - name: petejohanson
      url-base: https://github.com/petejohanson
  projects:
    - name: zmk
      remote: zmkfirmware
      revision: main
      import: app/west.yml
    - name: zmk-for-keyboards
      url: https://github.com/PandaKBLab/zmk-for-keyboards.git
      revision: master
      path: modules/zmk-for-keyboards
  self:
    path: config
```
